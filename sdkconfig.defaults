## sdkconfig.defaults
```kconfig
## DISPLAY CONFIG
CONFIG_WIDTH=135
CONFIG_HEIGHT=240
CONFIG_OFFSETX=52
CONFIG_OFFSETY=40
CONFIG_MOSI_GPIO=19
CONFIG_SCLK_GPIO=18
CONFIG_CS_GPIO=5
CONFIG_DC_GPIO=16
CONFIG_RESET_GPIO=23
CONFIG_BL_GPIO=4
```
